## package/cryptoauth-openssl-engine/Config.in
```kconfig
config BR2_PACKAGE_CRYPTOAUTH_OPENSSL_ENGINE
	bool "cryptoauth-openssl-engine"
	depends on BR2_PACKAGE_OPENSSL
	help
	  OpenSSL Engine implementation using ATECC508 for ECC key storage,
	  ECDSA sign/verify, ECDH, and FIPS Random Number Generator (RNG).

	  https://github.com/MicrochipTech/cryptoauth-openssl-engine

comment "cryptoauth-openssl-engine needs openssl"
	depends on !BR2_PACKAGE_OPENSSL
```

## package/cryptoauthlib/Config.in
```kconfig
config BR2_PACKAGE_CRYPTOAUTHLIB
	bool "cryptoauthlib"
	help
	  Library for interacting with the Crypto Authentication secure
	  elements 

	  https://github.com/MicrochipTech/cryptoauthlib
```

## package/rpi-fbcp/Config.in
```kconfig
config BR2_PACKAGE_RPI_FBCP
	bool "rpi-fbcp"
	help
	  Raspberry Pi framebuffer copy

	  https://github.com/tasanakorn/rpi-fbcp
```
